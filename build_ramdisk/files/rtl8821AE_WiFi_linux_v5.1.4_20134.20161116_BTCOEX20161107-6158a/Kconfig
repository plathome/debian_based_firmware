## build_ramdisk/files/rtl8821AE_WiFi_linux_v5.1.4_20134.20161116_BTCOEX20161107-6158a/Kconfig
```kconfig
config RTL8821AE
	tristate "Realtek 8821A PCI WiFi"
	depends on PCI
	---help---
	  Help message of RTL8821AE
```
